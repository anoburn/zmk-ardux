## boards/shields/cradio_left/Kconfig.defconfig
```kconfig
# Copyright (c) 2020 The ZMK Contributors
# SPDX-License-Identifier: MIT

if SHIELD_CRADIO_ARDUX_LEFT || SHIELD_CRADIO_ARDUX_THUMB_LEFT

config ZMK_KEYBOARD_NAME
	default "Ardux L"

endif
```

## boards/shields/cradio_left/Kconfig.shield
```kconfig
# Copyright (c) 2020 The ZMK Contributors
# SPDX-License-Identifier: MIT

config SHIELD_CRADIO_ARDUX_LEFT
	def_bool $(shields_list_contains,cradio_ardux_left)

config SHIELD_CRADIO_ARDUX_THUMB_LEFT
	def_bool $(shields_list_contains,cradio_ardux_thumb_left)
```

## boards/shields/cradio_right/Kconfig.defconfig
```kconfig
# Copyright (c) 2020 The ZMK Contributors
# SPDX-License-Identifier: MIT

if SHIELD_CRADIO_ARDUX_RIGHT || SHIELD_CRADIO_ARDUX_THUMB_RIGHT

config ZMK_KEYBOARD_NAME
	default "Ardux R"

endif
```

## boards/shields/cradio_right/Kconfig.shield
```kconfig
# Copyright (c) 2020 The ZMK Contributors
# SPDX-License-Identifier: MIT

config SHIELD_CRADIO_ARDUX_RIGHT
	def_bool $(shields_list_contains,cradio_ardux_right)

config SHIELD_CRADIO_ARDUX_THUMB_RIGHT
	def_bool $(shields_list_contains,cradio_ardux_thumb_right)
```

## boards/shields/tidbit_ardux_left/Kconfig.shield
```kconfig
# Copyright (c) 2021 Mike "KemoNine" Crosson
# SPDX-License-Identifier: MIT

config SHIELD_TIDBIT_ARDUX_LEFT
	def_bool $(shields_list_contains,tidbit_ardux_left)
```

## boards/shields/tidbit_ardux_right/Kconfig.shield
```kconfig
# Copyright (c) 2021 Mike "KemoNine" Crosson
# SPDX-License-Identifier: MIT

config SHIELD_TIDBIT_ARDUX_RIGHT
	def_bool $(shields_list_contains,tidbit_ardux_right)
```

## config/west.yml
```yaml
manifest:
  remotes:
    - name: zmkfirmware
      url-base: https://github.com/zmkfirmware
    - name: zmk-ardux
      url-base: https://github.com/arduxio
    - name: mcrosson
      url-base: https://github.com/mcrosson
  projects:
    - name: zmk
      remote: zmkfirmware
      revision: main
      import: app/west.yml
    - name: zmk-dynamic-bt-profile-names
      remote: mcrosson
      revision: main
  self:
    path: config
```
