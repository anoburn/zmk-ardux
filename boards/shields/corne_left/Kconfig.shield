## boards/shields/corne_left/Kconfig.shield
```kconfig
# Copyright (c) 2021 Mike "KemoNine" Crosson
# SPDX-License-Identifier: MIT

config SHIELD_CORNE_ARDUX_LEFT
	def_bool $(shields_list_contains,corne_ardux_left)

config SHIELD_CORNE_5_COL_ARDUX_LEFT
	def_bool $(shields_list_contains,corne_5_col_ardux_left)

config SHIELD_CORNE_5_COL_BIG_ARDUX_LEFT
	def_bool $(shields_list_contains,corne_5_col_big_ardux_left)
```

## boards/shields/corne_pro_bt_left/Kconfig.defconfig
```kconfig
if SHIELD_CORNE_PRO_BT_ARDUX_LEFT

config ZMK_KEYBOARD_NAME
	default "Corne ARDUX L"

config I2C
	default y

config SSD1306
	default y

config LV_Z_VDB_SIZE
	default 64

config LV_DPI_DEF
	default 148

config LV_Z_BITS_PER_PIXEL
	default 1

choice LV_COLOR_DEPTH
	default LV_COLOR_DEPTH_1
endchoice

endif
```

## boards/shields/corne_pro_bt_left/Kconfig.shield
```kconfig
# Copyright (c) 2021 Mike "KemoNine" Crosson
# SPDX-License-Identifier: MIT

config SHIELD_CORNE_PRO_BT_ARDUX_LEFT
	def_bool $(shields_list_contains,corne_pro_bt_left)
```

## boards/shields/corne_right/Kconfig.shield
```kconfig
# Copyright (c) 2021 Mike "KemoNine" Crosson
# SPDX-License-Identifier: MIT

config SHIELD_CORNE_ARDUX_RIGHT
	def_bool $(shields_list_contains,corne_ardux_right)

config SHIELD_CORNE_5_COL_ARDUX_RIGHT
	def_bool $(shields_list_contains,corne_5_col_ardux_right)

config SHIELD_CORNE_5_COL_BIG_ARDUX_RIGHT
	def_bool $(shields_list_contains,corne_5_col_big_ardux_right)
```

## config/boards/arm/corne_bt_pro/Kconfig.board
```kconfig
# Copyright (c) 2020 The ZMK Contributors
# SPDX-License-Identifier: MIT

config BOARD_CORNE_BT_PRO_LEFT
	bool "Corne BT Pro Left"
	depends on SOC_NRF52840_QIAA

config BOARD_CORNE_BT_PRO_RIGHT
    bool "Corne BT Pro Right"
    depends on SOC_NRF52840_QIAA
```

## config/boards/arm/corne_bt_pro/Kconfig.defconfig
```kconfig
if BOARD_CORNE_BT_PRO_LEFT

config ZMK_KEYBOARD_NAME
    default "Corne BT Pro"

config ZMK_SPLIT_ROLE_CENTRAL
    default y

endif

if BOARD_CORNE_BT_PRO_LEFT || BOARD_CORNE_BT_PRO_RIGHT

config BOARD
	default "corne_bt_pro"

config I2C
	default y

config ZMK_SPLIT
    default y

config BT_CTLR
	default BT

config ZMK_MAX17048
    default y

endif
```

## config/boards/arm/corne_choc_pro/Kconfig.defconfig
```kconfig
if BOARD_CORNE_CHOC_PRO_LEFT

config ZMK_SPLIT_ROLE_CENTRAL
    default y

endif

if BOARD_CORNE_CHOC_PRO_LEFT || BOARD_CORNE_CHOC_PRO_RIGHT

config BOARD
	default "corne_choc_pro"

config I2C
	default y

config ZMK_SPLIT
    default y

config BT_CTLR
	default BT

config ZMK_MAX17048
    default y

endif
```

## config/boards/shields/corne_bt_pro/Kconfig.defconfig
```kconfig
if SHIELD_CORNE_BT_PRO_LEFT

config ZMK_KEYBOARD_NAME
    default "Corne BT Pro"

config ZMK_SPLIT_ROLE_CENTRAL
    default y

endif

if SHIELD_CORNE_BT_PRO_LEFT || SHIELD_CORNE_BT_PRO_RIGHT

config I2C
	default y

config ZMK_SPLIT
    default y

endif
```

## config/boards/shields/corne_bt_pro/Kconfig.shield
```kconfig
config SHIELD_CORNE_BT_PRO_LEFT
    def_bool $(shields_list_contains,corne_bt_pro_left)

config SHIELD_CORNE_BT_PRO_RIGHT
    def_bool $(shields_list_contains,corne_bt_pro_right)
```
