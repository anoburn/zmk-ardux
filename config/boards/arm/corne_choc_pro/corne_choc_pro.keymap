/*
 * SPDX-License-Identifier: MIT
 */

#include <behaviors.dtsi>
#include <dt-bindings/zmk/keys.h>
#include <dt-bindings/zmk/bt.h>

// LEFT HALF
// ARTS Row
#define KEY_A_LEFT 4
#define KEY_R_LEFT 3
#define KEY_T_LEFT 2
#define KEY_S_LEFT 1
// EYIO Row
#define KEY_E_LEFT 18
#define KEY_Y_LEFT 17
#define KEY_I_LEFT 16
#define KEY_O_LEFT 15
// Lowest Row
#define KEY_LOWEST_0_LEFT 32
#define KEY_LOWEST_1_LEFT 31
#define KEY_LOWEST_2_LEFT 30
#define KEY_LOWEST_3_LEFT 29

// RIGHT HALF
// ARTS Row
#define KEY_A_RIGHT 9
#define KEY_R_RIGHT 10
#define KEY_T_RIGHT 11
#define KEY_S_RIGHT 12
// EYIO Row
#define KEY_E_RIGHT 23
#define KEY_Y_RIGHT 24
#define KEY_I_RIGHT 25
#define KEY_O_RIGHT 26
// Lowest Row
#define KEY_LOWEST_0_RIGHT 35
#define KEY_LOWEST_1_RIGHT 36
#define KEY_LOWEST_2_RIGHT 37
#define KEY_LOWEST_3_RIGHT 38

// Big ardux F1-12 layer keys for combo
#define KEY_F_TOP 0
#define KEY_F_BOTTOM 6

// Define Offsets
#define LEADING_NONES NONE(0,0,1)
#define MIDDLE_NONES NONE(0, 0, 1)
#define TRAILING_NONES NONE(0, 0, 8)
#define BIG_LEADING_NONES NONE(0, 0, 0)
#define BIG_BETWEEN_ROW_ONE_TWO_NONES NONE(0, 0, 0)
#define BIG_BETWEEN_ROW_TWO_THREE_NONES NONE(0, 0, 0)
#define BIG_BETWEEN_ROW_THREE_THUMBS NONE(0, 0, 0)
#define BIG_TRAILING_NONES NONE(0, 0, 0)
#define SPLIT_ROW_ONE_NONES NONE(0, 0, 2)
#define SPLIT_ROW_TWO_NONES NONE(0, 0, 2)
#define SPLIT_ROW_THREE_NONES NONE(0, 0, 0)
#define SPLIT_ROW_THUMB_NONES NONE(0, 0, 0)

// Include main ardux.io keymap
#include "../../../ardux_two_handed.dtsi"
