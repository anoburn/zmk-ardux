/*
 * Copyright (c) 2021 Mike "KemoNine" Crosson
 *
 * SPDX-License-Identifier: MIT
 */

#include <behaviors.dtsi>
#include <dt-bindings/zmk/keys.h>
#include <dt-bindings/zmk/outputs.h>
#include <dt-bindings/zmk/pointing.h>

/*****************************************
 * Macros for filling in "&none" in the right places in the keymap for re-use needs
 *****************************************/
#define NONE0(X)
#define NONE1(X) X
#define NONE2(X) NONE1(X) X
#define NONE3(X) NONE2(X) X
#define NONE4(X) NONE3(X) X
#define NONE5(X) NONE4(X) X
#define NONE6(X) NONE5(X) X
#define NONE7(X) NONE6(X) X
#define NONE8(X) NONE7(X) X
#define NONE9(X) NONE8(X) X
#define NONE10(X) NONE9(X) X

#define NONE(HUNDREDS,TENS,ONES) \
  NONE##HUNDREDS(NONE10(NONE10(&none))) \
  NONE##TENS(NONE10(&none)) \
  NONE##ONES(&none)

/*****************************************
 * ARDUX website : https://www.ardux.io
 * Primary reference : https://www.ardux.io/_FILES/images/ARDUX.jpg
*****************************************/

/*****************************************
 * Define custom BT layer extra keys
 *
 * You can override the 2 blank keys on the BT select layer by copy/pasting the below into your keymap
 *     *before* including the ardux.dtsfile
 * Once added to your keymap you can adjust these 2 keys as you see fit
*****************************************/
#if !defined ARDUX_BT_TOP
#define ARDUX_BT_TOP &out OUT_BLE
#endif
#if !defined ARDUX_BT_BOTTOM
#define ARDUX_BT_BOTTOM &out OUT_USB
#endif

/*****************************************
 * Define how long it takes for the combos/holds to 'time out'
 * See documentation on "combos" for more detail
 * THE COMBO TIMEOUTS MUST BE THE SAME
 *    https://github.com/zmkfirmware/zmk/issues/905
 *****************************************/
#if !defined TIMEOUT_COMBO_2
#define TIMEOUT_COMBO_2 175
#endif
#if !defined TIMEOUT_COMBO_3
#define TIMEOUT_COMBO_3 175
#endif
#if !defined TIMEOUT_COMBO_4
#define TIMEOUT_COMBO_4 175
#endif
#if !defined TIMEOUT_LAYER_HOLD
#define TIMEOUT_LAYER_HOLD 200
#endif
#if !defined TIMEOUT_STICKY_LEADER_KEY
#define TIMEOUT_STICKY_LEADER_KEY 5000
#endif
&sk {
	release-after-ms = <TIMEOUT_STICKY_LEADER_KEY>;
};
&sl { 
	release-after-ms = <TIMEOUT_STICKY_LEADER_KEY>;
};
&mmv {
	time-to-max-speed-ms = <0>;
};
&msc {
	time-to-max-speed-ms = <0>;
};

/*****************************************
* Define base layer chars for 'standard ARDUX' or 'COLEMAK' inspired (you can add more by following the pattern below)
* Turn on the ARDUX_COLEMAK definition above if you want this change
*****************************************/
#define ARDUX_BASE_A A
#define ARDUX_BASE_R R
#define ARDUX_BASE_T T
#define ARDUX_BASE_S S
#define ARDUX_BASE_E E
#define ARDUX_BASE_Y Y
#define ARDUX_BASE_I I
#define ARDUX_BASE_O O
#define ARDUX_COMBO_N N
#if ARDUX_COLEMAK
#define ARDUX_BASE_A T
#define ARDUX_BASE_R S
#define ARDUX_BASE_T R
#define ARDUX_BASE_S A
#define ARDUX_BASE_E N
#define ARDUX_BASE_Y E
#define ARDUX_BASE_I I
#define ARDUX_BASE_O O
#define ARDUX_COMBO_N Y
#endif

/*****************************************
* Layer IDs used by the ARDUX keymap
* Do NOT change these and do NOT change the order of the layers as shown below
*****************************************/
#define LAYER_ID_GLOBAL -1
#define LAYER_ID_BASE 0
#define LAYER_ID_NUMBERS 1
#define LAYER_ID_SYMBOLS 2
#define LAYER_ID_PARENTHETICALS 3
#define LAYER_ID_NAVIGATION 4
#define LAYER_ID_BT_SEL 5
#define LAYER_ID_MOUSE 6
#define LAYER_ID_CUSTOM 7
#define LAYER_ID_BIG_SYM 8
#define LAYER_ID_BIG_FUNCTION 9
#define LAYER_ID_QWERTY 10

#define COMBO_NAME(TEXT, SUFFIX) TEXT##_##SUFFIX

/*****************************************
 * This macro creates all the combos for one side of a keyboard.
 * It receives the keycodes for each base key, as well as a suffix to avoid duplicate node names.
 * For one-handed keyboards, call it once.
 * For two-handed keyboards, call it twice, once for each side.
*****************************************/
#define create_base_combos(MACRO_KEY_A, MACRO_KEY_R, MACRO_KEY_T, MACRO_KEY_S, MACRO_KEY_E, MACRO_KEY_Y, MACRO_KEY_I, MACRO_KEY_O, NAME_SUFFIX) \
	/*****************************************
	* 2 key combos
	*****************************************/ \
		COMBO_NAME(combo_enter, NAME_SUFFIX)      { timeout-ms = <TIMEOUT_COMBO_2>; key-positions = <MACRO_KEY_A MACRO_KEY_E>; bindings = <&kp ENTER>; }; \
		COMBO_NAME(combo_control, NAME_SUFFIX)    { timeout-ms = <TIMEOUT_COMBO_2>; key-positions = <MACRO_KEY_E MACRO_KEY_S>; bindings = <&sk LCTRL>; }; \
		COMBO_NAME(combo_gui, NAME_SUFFIX)        { timeout-ms = <TIMEOUT_COMBO_2>; key-positions = <MACRO_KEY_Y MACRO_KEY_S>; bindings = <&sk LGUI>; }; \
		COMBO_NAME(combo_alt, NAME_SUFFIX)        { timeout-ms = <TIMEOUT_COMBO_2>; key-positions = <MACRO_KEY_I MACRO_KEY_S>; bindings = <&sk LALT>; }; \
		COMBO_NAME(combo_backspace, NAME_SUFFIX)  { timeout-ms = <TIMEOUT_COMBO_2>; key-positions = <MACRO_KEY_E MACRO_KEY_R>; bindings = <&kp BACKSPACE>; }; \
		COMBO_NAME(combo_delete, NAME_SUFFIX)     { timeout-ms = <TIMEOUT_COMBO_2>; key-positions = <MACRO_KEY_I MACRO_KEY_R>; bindings = <&kp DELETE>; }; \
		COMBO_NAME(combo_shift_lock, NAME_SUFFIX) { timeout-ms = <TIMEOUT_COMBO_2>; key-positions = <MACRO_KEY_R MACRO_KEY_Y>; bindings = <&kt LSHFT>; }; \
 \
		COMBO_NAME(combo_b, NAME_SUFFIX)           { layers = <LAYER_ID_BASE>; timeout-ms = <TIMEOUT_COMBO_2>; key-positions = <MACRO_KEY_E MACRO_KEY_O>; bindings = <&kp B>; }; \
		COMBO_NAME(combo_c, NAME_SUFFIX)           { layers = <LAYER_ID_BASE>; timeout-ms = <TIMEOUT_COMBO_2>; key-positions = <MACRO_KEY_E MACRO_KEY_Y>; bindings = <&kp C>; }; \
		COMBO_NAME(combo_n, NAME_SUFFIX)           { layers = <LAYER_ID_BASE>; timeout-ms = <TIMEOUT_COMBO_2>; key-positions = <MACRO_KEY_I MACRO_KEY_O>; bindings = <&kp ARDUX_COMBO_N>; }; \
		COMBO_NAME(combo_f, NAME_SUFFIX)           { layers = <LAYER_ID_BASE>; timeout-ms = <TIMEOUT_COMBO_2>; key-positions = <MACRO_KEY_A MACRO_KEY_R>; bindings = <&kp F>; }; \
		COMBO_NAME(combo_g, NAME_SUFFIX)           { layers = <LAYER_ID_BASE>; timeout-ms = <TIMEOUT_COMBO_2>; key-positions = <MACRO_KEY_R MACRO_KEY_T>; bindings = <&kp G>; }; \
		COMBO_NAME(combo_u, NAME_SUFFIX)           { layers = <LAYER_ID_BASE>; timeout-ms = <TIMEOUT_COMBO_2>; key-positions = <MACRO_KEY_Y MACRO_KEY_I>; bindings = <&kp U>; }; \
		COMBO_NAME(combo_h, NAME_SUFFIX)           { layers = <LAYER_ID_BASE>; timeout-ms = <TIMEOUT_COMBO_2>; key-positions = <MACRO_KEY_E MACRO_KEY_I>; bindings = <&kp H>; }; \
		COMBO_NAME(combo_v, NAME_SUFFIX)           { layers = <LAYER_ID_BASE>; timeout-ms = <TIMEOUT_COMBO_2>; key-positions = <MACRO_KEY_R MACRO_KEY_S>; bindings = <&kp V>; }; \
		COMBO_NAME(combo_j, NAME_SUFFIX)           { layers = <LAYER_ID_BASE>; timeout-ms = <TIMEOUT_COMBO_2>; key-positions = <MACRO_KEY_T MACRO_KEY_S>; bindings = <&kp J>; }; \
		COMBO_NAME(combo_w, NAME_SUFFIX)           { layers = <LAYER_ID_BASE>; timeout-ms = <TIMEOUT_COMBO_2>; key-positions = <MACRO_KEY_A MACRO_KEY_S>; bindings = <&kp W>; }; \
		COMBO_NAME(combo_k, NAME_SUFFIX)           { layers = <LAYER_ID_BASE>; timeout-ms = <TIMEOUT_COMBO_2>; key-positions = <MACRO_KEY_Y MACRO_KEY_O>; bindings = <&kp K>; }; \
		COMBO_NAME(combo_period, NAME_SUFFIX)      { layers = <LAYER_ID_BASE>; timeout-ms = <TIMEOUT_COMBO_2>; key-positions = <MACRO_KEY_A MACRO_KEY_Y>; bindings = <&kp PERIOD>; }; \
		COMBO_NAME(combo_comma, NAME_SUFFIX)       { layers = <LAYER_ID_BASE>; timeout-ms = <TIMEOUT_COMBO_2>; key-positions = <MACRO_KEY_A MACRO_KEY_I>; bindings = <&kp COMMA>; }; \
		COMBO_NAME(combo_slash, NAME_SUFFIX)       { layers = <LAYER_ID_BASE>; timeout-ms = <TIMEOUT_COMBO_2>; key-positions = <MACRO_KEY_A MACRO_KEY_O>; bindings = <&kp SLASH>; }; \
		COMBO_NAME(combo_exclamation, NAME_SUFFIX) { layers = <LAYER_ID_BASE>; timeout-ms = <TIMEOUT_COMBO_2>; key-positions = <MACRO_KEY_T MACRO_KEY_I>; bindings = <&kp EXCL>; }; \
		 \
		COMBO_NAME(combo_seven, NAME_SUFFIX) { layers = <LAYER_ID_NUMBERS>; timeout-ms = <TIMEOUT_COMBO_2>; key-positions = <MACRO_KEY_A MACRO_KEY_R>; bindings = <&kp N7>; }; \
		COMBO_NAME(combo_eight, NAME_SUFFIX) { layers = <LAYER_ID_NUMBERS>; timeout-ms = <TIMEOUT_COMBO_2>; key-positions = <MACRO_KEY_R MACRO_KEY_T>; bindings = <&kp N8>; }; \
		COMBO_NAME(combo_nine, NAME_SUFFIX)  { layers = <LAYER_ID_NUMBERS>; timeout-ms = <TIMEOUT_COMBO_2>; key-positions = <MACRO_KEY_E MACRO_KEY_Y>; bindings = <&kp N9>; }; \
		COMBO_NAME(combo_zero, NAME_SUFFIX)  { layers = <LAYER_ID_NUMBERS>; timeout-ms = <TIMEOUT_COMBO_2>; key-positions = <MACRO_KEY_Y MACRO_KEY_I>; bindings = <&kp N0>; }; \
 \
		COMBO_NAME(combo_num_period, NAME_SUFFIX) { layers = <LAYER_ID_NUMBERS>; timeout-ms = <TIMEOUT_COMBO_2>; key-positions = <MACRO_KEY_Y MACRO_KEY_A>; bindings = <&kp PERIOD>; }; \
		COMBO_NAME(combo_num_comma, NAME_SUFFIX) { layers = <LAYER_ID_NUMBERS>; timeout-ms = <TIMEOUT_COMBO_2>; key-positions = <MACRO_KEY_I MACRO_KEY_A>; bindings = <&kp COMMA>; }; \
		COMBO_NAME(combo_num_enter, NAME_SUFFIX)  { layers = <LAYER_ID_NUMBERS>; timeout-ms = <TIMEOUT_COMBO_2>; key-positions = <MACRO_KEY_E MACRO_KEY_A>; bindings = <&kp ENTER>; }; \
 \
		/*****************************************
		 * 3 key combos
		 *****************************************/ \
		COMBO_NAME(combo_esc, NAME_SUFFIX)              { timeout-ms = <TIMEOUT_COMBO_3>; key-positions = <MACRO_KEY_A MACRO_KEY_R MACRO_KEY_O>; bindings = <&kp ESC>; }; \
		COMBO_NAME(combo_layer_navigation, NAME_SUFFIX) { timeout-ms = <TIMEOUT_COMBO_3>; key-positions = <MACRO_KEY_R MACRO_KEY_E MACRO_KEY_I>; bindings = <&tog LAYER_ID_NAVIGATION>; }; \
		COMBO_NAME(combo_layer_mouse, NAME_SUFFIX)      { timeout-ms = <TIMEOUT_COMBO_3>; key-positions = <MACRO_KEY_A MACRO_KEY_T MACRO_KEY_Y>; bindings = <&tog LAYER_ID_MOUSE>; }; \
 \
		COMBO_NAME(combo_m, NAME_SUFFIX)            { layers = <LAYER_ID_BASE>; timeout-ms = <TIMEOUT_COMBO_3>; key-positions = <MACRO_KEY_Y MACRO_KEY_I MACRO_KEY_O>; bindings = <&kp M>; }; \
		COMBO_NAME(combo_d, NAME_SUFFIX)            { layers = <LAYER_ID_BASE>; timeout-ms = <TIMEOUT_COMBO_3>; key-positions = <MACRO_KEY_A MACRO_KEY_R MACRO_KEY_T>; bindings = <&kp D>; }; \
		COMBO_NAME(combo_p, NAME_SUFFIX)            { layers = <LAYER_ID_BASE>; timeout-ms = <TIMEOUT_COMBO_3>; key-positions = <MACRO_KEY_E MACRO_KEY_I MACRO_KEY_O>; bindings = <&kp P>; }; \
		COMBO_NAME(combo_q, NAME_SUFFIX)            { layers = <LAYER_ID_BASE>; timeout-ms = <TIMEOUT_COMBO_3>; key-positions = <MACRO_KEY_A MACRO_KEY_T MACRO_KEY_S>; bindings = <&kp Q>; }; \
		COMBO_NAME(combo_x, NAME_SUFFIX)            { layers = <LAYER_ID_BASE>; timeout-ms = <TIMEOUT_COMBO_3>; key-positions = <MACRO_KEY_R MACRO_KEY_T MACRO_KEY_S>; bindings = <&kp X>; }; \
		COMBO_NAME(combo_l, NAME_SUFFIX)            { layers = <LAYER_ID_BASE>; timeout-ms = <TIMEOUT_COMBO_3>; key-positions = <MACRO_KEY_E MACRO_KEY_Y MACRO_KEY_I>; bindings = <&kp L>; }; \
		COMBO_NAME(combo_single_quote, NAME_SUFFIX) { layers = <LAYER_ID_BASE>; timeout-ms = <TIMEOUT_COMBO_3>; key-positions = <MACRO_KEY_A MACRO_KEY_Y MACRO_KEY_I>; bindings = <&kp SQT>; }; \
		 \
		/*****************************************
		 * 4 key combos
		 *****************************************/ \
		COMBO_NAME(combo_tab, NAME_SUFFIX)             { timeout-ms = <TIMEOUT_COMBO_4>; key-positions = <MACRO_KEY_A MACRO_KEY_R MACRO_KEY_T MACRO_KEY_O>; bindings = <&kp TAB>; }; \
		COMBO_NAME(combo_space, NAME_SUFFIX)           { timeout-ms = <TIMEOUT_COMBO_4>; key-positions = <MACRO_KEY_E MACRO_KEY_Y MACRO_KEY_I MACRO_KEY_O>; bindings = <&kp SPACE>; }; \
		COMBO_NAME(combo_shift, NAME_SUFFIX)           { timeout-ms = <TIMEOUT_COMBO_4>; key-positions = <MACRO_KEY_E MACRO_KEY_R MACRO_KEY_T MACRO_KEY_S>; bindings = <&sk LSHFT>; }; \
		COMBO_NAME(combo_layer_bt_select, NAME_SUFFIX) { timeout-ms = <TIMEOUT_COMBO_4>; key-positions = <MACRO_KEY_A MACRO_KEY_E MACRO_KEY_S MACRO_KEY_O>; bindings = <&tog LAYER_ID_BT_SEL>; }; \
		COMBO_NAME(combo_bt_clr, NAME_SUFFIX)          { timeout-ms = <TIMEOUT_COMBO_4>; key-positions = <MACRO_KEY_R MACRO_KEY_Y MACRO_KEY_T MACRO_KEY_I>; bindings = <&bt BT_CLR>; }; \
 \
		COMBO_NAME(combo_z, NAME_SUFFIX)         { layers = <LAYER_ID_BASE>; timeout-ms = <TIMEOUT_COMBO_4>; key-positions = <MACRO_KEY_A MACRO_KEY_R MACRO_KEY_T MACRO_KEY_S>; bindings = <&kp Z>; }; \
		COMBO_NAME(combo_caps_lock, NAME_SUFFIX) { layers = <LAYER_ID_BASE>; timeout-ms = <TIMEOUT_COMBO_4>; key-positions = <MACRO_KEY_O MACRO_KEY_I MACRO_KEY_Y MACRO_KEY_A>; bindings = <&kp CAPS>; }; \

/*****************************************
* Standard ARDUX combo definitions
* These should NOT be changed and are global in scope
*****************************************/
/ {
	combos {
		compatible = "zmk,combos";
		
		// Function layer doesn't apply to non-big ardux presently
		#if defined ARDUX_BIG
		combo_layer_functions { key-positions = <KEY_F_TOP KEY_F_BOTTOM>; bindings = <&sl LAYER_ID_BIG_FUNCTION>; };
		#endif

		#if defined KEY_A && defined KEY_R && defined KEY_T && defined KEY_S && defined KEY_E && defined KEY_Y && defined KEY_I && defined KEY_O
		create_base_combos(KEY_A, KEY_R, KEY_T, KEY_S, KEY_E, KEY_Y, KEY_I, KEY_O, main)
		#endif

		#if defined KEY_A_LEFT && defined KEY_R_LEFT && defined KEY_T_LEFT && defined KEY_S_LEFT && defined KEY_E_LEFT && defined KEY_Y_LEFT && defined KEY_I_LEFT && defined KEY_O_LEFT
		create_base_combos(KEY_A_LEFT, KEY_R_LEFT, KEY_T_LEFT, KEY_S_LEFT, KEY_E_LEFT, KEY_Y_LEFT, KEY_I_LEFT, KEY_O_LEFT, left)
		#endif
		#if defined KEY_A_RIGHT && defined KEY_R_RIGHT && defined KEY_T_RIGHT && defined KEY_S_RIGHT && defined KEY_E_RIGHT && defined KEY_Y_RIGHT && defined KEY_I_RIGHT && defined KEY_O_RIGHT
		create_base_combos(KEY_A_RIGHT, KEY_R_RIGHT, KEY_T_RIGHT, KEY_S_RIGHT, KEY_E_RIGHT, KEY_Y_RIGHT, KEY_I_RIGHT, KEY_O_RIGHT, right)
		#endif

		#if defined USE_SPLIT_COMBOS
		combo_layer_qwerty_left		{ layers = <LAYER_ID_BASE LAYER_ID_QWERTY>; timeout-ms = <TIMEOUT_COMBO_4>; key-positions = <KEY_LOWEST_0_LEFT KEY_LOWEST_1_LEFT KEY_LOWEST_2_LEFT KEY_LOWEST_3_LEFT>; bindings = <&tog LAYER_ID_QWERTY>; };
		combo_layer_qwerty_right	{ layers = <LAYER_ID_BASE LAYER_ID_QWERTY>; timeout-ms = <TIMEOUT_COMBO_4>; key-positions = <KEY_LOWEST_0_RIGHT KEY_LOWEST_1_RIGHT KEY_LOWEST_2_RIGHT KEY_LOWEST_3_RIGHT>; bindings = <&tog LAYER_ID_QWERTY>; };
		#endif
	};

	macros {
		m_sch: m_sch {
			compatible = "zmk,behavior-macro";
	#binding-cells = <0>;
	bindings = <&kp S &kp C &kp H>;
	display-name = "M_SCH";
		};
	};
};

/*****************************************
 * Standard ARDUX layer activation definitions
 * These should NOT be changed and are global in scope
 *****************************************/
/ {
	behaviors {
		layer_base_kp: layer_base_kp { compatible = "zmk,behavior-hold-tap"; display-name = "layer_base_kp";
						#binding-cells = <2>; tapping-term-ms = <TIMEOUT_LAYER_HOLD>; flavor = "tap-preferred";
						bindings = <&mo>, <&kp>; };
		layer_numbers_kp: layer_numbers_kp { compatible = "zmk,behavior-hold-tap"; display-name = "layer_numbers_kp";
						#binding-cells = <2>; tapping-term-ms = <TIMEOUT_LAYER_HOLD>; flavor = "tap-preferred";
						bindings = <&mo>, <&kp>; };
		layer_symbols_kp: layer_symbols_kp { compatible = "zmk,behavior-hold-tap"; display-name = "layer_symbols_kp";
						#binding-cells = <2>; tapping-term-ms = <TIMEOUT_LAYER_HOLD>; flavor = "tap-preferred";
						bindings = <&mo>, <&kp>; };
		layer_parentheticals_kp: layer_parentheticals_kp { compatible = "zmk,behavior-hold-tap"; display-name = "layer_parentheticals_kp";
						#binding-cells = <2>; tapping-term-ms = <TIMEOUT_LAYER_HOLD>; flavor = "tap-preferred";
						bindings = <&mo>, <&kp>; };
		layer_custom_kp: layer_custom_kp { compatible = "zmk,behavior-hold-tap"; display-name = "layer_custom_kp";
						#binding-cells = <2>; tapping-term-ms = <TIMEOUT_LAYER_HOLD>; flavor = "tap-preferred";
						bindings = <&mo>, <&kp>; };
		ctrl_alt_kp: ctrl_alt_kp { compatible = "zmk,behavior-hold-tap"; display-name = "ctrl_alt_kp";
						#binding-cells = <2>; tapping-term-ms = <TIMEOUT_LAYER_HOLD>; flavor = "tap-preferred";
						bindings = <&sk>, <&sk>; };
	};
};
